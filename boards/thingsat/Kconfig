## boards/thingsat/Kconfig
```kconfig
# Copyright (c) 2020 Université Grenoble Alpes
#
# This file is subject to the terms and conditions of the GNU Lesser
# General Public License v2.1. See the file LICENSE in the top level
# directory for more details.
#

config BOARD
    default "thingsat" if BOARD_THINGSAT

config BOARD_THINGSAT
    bool
    default y
    select CPU_MODEL_STM32L051K8

    # Put defined MCU peripherals here (in alphabetical order)
    select HAS_PERIPH_PWM
    select HAS_PERIPH_RTC
    select HAS_PERIPH_RTT
    select HAS_PERIPH_SPI
    select HAS_PERIPH_TIMER
    select HAS_PERIPH_UART
```
